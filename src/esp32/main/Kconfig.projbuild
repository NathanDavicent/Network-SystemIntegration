## src/esp32/main/Kconfig.projbuild
```kconfig
menu "IoT Configuration"

    config WIFI_SSID
        string "Wi-Fi SSID"
        default ""

    config WIFI_PASSWORD
        string "Wi-Fi password"
        default ""
    config MQTT_BROKER_URI
        string "MQTT broker URI"
        default "mqtt://192.168.50.254:1883"

endmenu
```
